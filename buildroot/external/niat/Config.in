## buildroot/external/niat/Config.in
```kconfig
menu "NIAT Packages"
    source "$BR2_EXTERNAL_NIAT_PATH/package/agent-kernel/Config.in"
    source "$BR2_EXTERNAL_NIAT_PATH/package/niat-tui/Config.in"
    source "$BR2_EXTERNAL_NIAT_PATH/package/mcp-client/Config.in"
    source "$BR2_EXTERNAL_NIAT_PATH/package/niat-installer/Config.in"
endmenu
```

## buildroot/external/niat/configs/niat_x86_64_defconfig
```kconfig
# NIAT x86_64 Buildroot defconfig
BR2_x86_64=y
BR2_x86_corei7=y

# Toolchain
BR2_TOOLCHAIN_BUILDROOT_MUSL=y
BR2_PACKAGE_HOST_RUSTC_TARGET_ARCH_SUPPORTS=y
BR2_TOOLCHAIN_BUILDROOT_CXX=y

# System
BR2_TARGET_GENERIC_HOSTNAME="niat"
BR2_TARGET_GENERIC_ISSUE="NIAT: The Intent-Driven Operating System (v0.1)"
BR2_INIT_BUSYBOX=y
BR2_ROOTFS_OVERLAY="$(BR2_EXTERNAL_NIAT_PATH)/board/x86_64/rootfs-overlay"
BR2_ROOTFS_POST_BUILD_SCRIPT="$(BR2_EXTERNAL_NIAT_PATH)/board/x86_64/post-build.sh"

# Kernel
BR2_LINUX_KERNEL=y
BR2_LINUX_KERNEL_CUSTOM_VERSION=y
BR2_LINUX_KERNEL_CUSTOM_VERSION_VALUE="6.6.21"
BR2_LINUX_KERNEL_USE_CUSTOM_CONFIG=y
BR2_LINUX_KERNEL_CUSTOM_CONFIG_FILE="$(BR2_EXTERNAL_NIAT_PATH)/board/x86_64/linux.config"
BR2_LINUX_KERNEL_BZIMAGE=y
BR2_LINUX_KERNEL_NEEDS_HOST_OPENSSL=y

# Base Utilities
BR2_PACKAGE_BUSYBOX_CONFIG_FILE="$(BR2_EXTERNAL_NIAT_PATH)/board/x86_64/busybox.config"
BR2_PACKAGE_IPROUTE2=y
BR2_PACKAGE_DHCPCD=y
BR2_PACKAGE_E2FSPROGS=y
BR2_PACKAGE_DOSFSTOOLS=y
BR2_PACKAGE_UTIL_LINUX=y
BR2_PACKAGE_UTIL_LINUX_LIBBLKID=y
BR2_PACKAGE_UTIL_LINUX_LIBMOUNT=y
BR2_PACKAGE_CA_CERTIFICATES=y

# NIAT Core Packages
BR2_PACKAGE_AGENT_KERNEL=y
BR2_PACKAGE_NIAT_TUI=y
BR2_PACKAGE_MCP_CLIENT=y
BR2_PACKAGE_NIAT_INSTALLER=y

# Bootloader
BR2_TARGET_GRUB2=y
BR2_TARGET_GRUB2_X86_64_EFI=y
BR2_TARGET_GRUB2_BOOT_PARTITION="rootfs"

# Target Filesystems
BR2_TARGET_ROOTFS_EXT4=y
BR2_TARGET_ROOTFS_EXT4_SIZE="250M"
BR2_TARGET_ROOTFS_CPIO=y
BR2_TARGET_ROOTFS_CPIO_GZ=y
BR2_TARGET_ROOTFS_ISO9660=y
BR2_TARGET_ROOTFS_ISO9660_BOOT_MENU="$(BR2_EXTERNAL_NIAT_PATH)/board/x86_64/grub.cfg"
```

## buildroot/external/niat/package/agent-kernel/Config.in
```kconfig
config BR2_PACKAGE_AGENT_KERNEL
    bool "agent-kernel"
    depends on BR2_PACKAGE_HOST_RUSTC_TARGET_ARCH_SUPPORTS
    select BR2_PACKAGE_HOST_RUSTC
    help
      NIAT Agent Kernel - core system daemon.
```

## buildroot/external/niat/package/mcp-client/Config.in
```kconfig
config BR2_PACKAGE_MCP_CLIENT
    bool "mcp-client"
    depends on BR2_PACKAGE_HOST_RUSTC_TARGET_ARCH_SUPPORTS
    select BR2_PACKAGE_HOST_RUSTC
    help
      NIAT MCP Client - Model Context Protocol client engine.
```

## buildroot/external/niat/package/niat-installer/Config.in
```kconfig
config BR2_PACKAGE_NIAT_INSTALLER
    bool "niat-installer"
    depends on BR2_PACKAGE_HOST_RUSTC_TARGET_ARCH_SUPPORTS
    select BR2_PACKAGE_HOST_RUSTC
    help
      NIAT System Installer - disk partitioning and OS installation engine.
```

## buildroot/external/niat/package/niat-tui/Config.in
```kconfig
config BR2_PACKAGE_NIAT_TUI
    bool "niat-tui"
    depends on BR2_PACKAGE_HOST_RUSTC_TARGET_ARCH_SUPPORTS
    select BR2_PACKAGE_HOST_RUSTC
    help
      NIAT Terminal UI - interactive console interface.
```
